;Program compiled by Great Cow BASIC (0.98.07 2021-11-15 (Windows 32 bit) : Build 1050) for Microchip PIC-AS
;Need help? See the GCBASIC forums at http://sourceforge.net/projects/gcbasic/forums,
;check the documentation or email evan+picas at anobium  dot co dot uk.

;********************************************************************************


;Set up the assembler options (Chip type, clock source, other bits and pieces)
;PROCESSOR   18F4520
 PAGEWIDTH   132
 RADIX       DEC
 TITLE       "D:\Great-Cow-BASIC-Library-Development.git\trunk\Ethernet\ENC28J60\29022016\18F4520\ep2enc28j60InitTest005.S"
 SUBTITLE    "11-25-2021"

; Reverse lookup file(s)
; C:\Program Files\Microchip\xc8\v2.32\pic\include\proc\pic18f4520.inc
; C:\Program Files\Microchip\xc8\v2.32\pic\dat\cfgmap\18f4520.cfgmap
; Alternative CONFIG file is to be found at C:\Program Files\Microchip\xc8\vX.YY\pic\dat\cfgdata as per Microchip support ticket #00730936 

;********************************************************************************
;Explicit PIC-AS constants to resolve the crazyness of the PIC-AS syntax
;These are therefore the same as MPASM
#define BANKED b
#define ACCESS a
#define UPPER low highword

;********************************************************************************
;Explicit CONFIG
 CONFIG WRTD=OFF                                 ;C1 Reverselookup  WRTD = OFF
 CONFIG WRTB=OFF                                 ;C1 Reverselookup  WRTB = OFF
 CONFIG CPD=OFF                                  ;C1 Reverselookup  CPD = OFF
 CONFIG XINST=OFF                                ;C1 Reverselookup  XINST = OFF
 CONFIG LVP=OFF                                  ;C1 Reverselookup  LVP = OFF
 CONFIG MCLRE=ON                                 ;C1 Reverselookup  MCLRE = ON
 CONFIG WDT=OFF                                  ;C1 Reverselookup  WDT = OFF
 CONFIG FCMEN=ON                                 ;C1 Reverselookup  FCMEN = ON
 CONFIG OSC=HS                                   ;C1 Reverselookup  OSC = HS
;Inferred CONFIG
 CONFIG BOREN=SBORDIS                            ;C1 Reverselookup BOREN=SBORDIS
 CONFIG BORV=3                                   ;C1 Reverselookup BORV=3
 CONFIG CCP2MX=PORTC                             ;C1 Reverselookup CCP2MX=PORTC
 CONFIG CP0=OFF                                  ;C1 Reverselookup CP0=OFF
 CONFIG CP1=OFF                                  ;C1 Reverselookup CP1=OFF
 CONFIG CP2=OFF                                  ;C1 Reverselookup CP2=OFF
 CONFIG CP3=OFF                                  ;C1 Reverselookup CP3=OFF
 CONFIG CPB=OFF                                  ;C1 Reverselookup CPB=OFF
 CONFIG DEBUG=OFF                                ;C1 Reverselookup DEBUG=OFF
 CONFIG EBTR0=OFF                                ;C1 Reverselookup EBTR0=OFF
 CONFIG EBTR1=OFF                                ;C1 Reverselookup EBTR1=OFF
 CONFIG EBTR2=OFF                                ;C1 Reverselookup EBTR2=OFF
 CONFIG EBTR3=OFF                                ;C1 Reverselookup EBTR3=OFF
 CONFIG EBTRB=OFF                                ;C1 Reverselookup EBTRB=OFF
 CONFIG IESO=OFF                                 ;C1 Reverselookup IESO=OFF
 CONFIG LPT1OSC=OFF                              ;C1 Reverselookup LPT1OSC=OFF
 CONFIG PBADEN=ON                                ;C1 Reverselookup PBADEN=ON
 CONFIG PWRT=OFF                                 ;C1 Reverselookup PWRT=OFF
 CONFIG STVREN=ON                                ;C1 Reverselookup STVREN=ON
 CONFIG WDTPS=32768                              ;C1 Reverselookup WDTPS=32768
 CONFIG WRT0=OFF                                 ;C1 Reverselookup WRT0=OFF
 CONFIG WRT1=OFF                                 ;C1 Reverselookup WRT1=OFF
 CONFIG WRT2=OFF                                 ;C1 Reverselookup WRT2=OFF
 CONFIG WRT3=OFF                                 ;C1 Reverselookup WRT3=OFF
 CONFIG WRTC=OFF                                 ;C1 Reverselookup WRTC=OFF


;********************************************************************************
; The XC8 xc.inc include file.  This MUST be placed after the CONFIG statements.
; The position is a fix at PIC-AS.EXE 2.32 to resolve 'syntax errors'

 #include <xc.inc>

;********************************************************************************

;Set aside RAM memory locations for variables. All variables are global.
GLOBAL	ADDR
 ADDR                             EQU 10                    ; 0XA
GLOBAL	BANKTOBESELECTED
 BANKTOBESELECTED                 EQU 11                    ; 0XB
GLOBAL	COMPORT
 COMPORT                          EQU 12                    ; 0XC
GLOBAL	DELAYTEMP
 DELAYTEMP                        EQU 0                    ; 0X0
GLOBAL	DELAYTEMP2
 DELAYTEMP2                       EQU 1                    ; 0X1
GLOBAL	ENC28J60_READREG
 ENC28J60_READREG                 EQU 13                    ; 0XD
GLOBAL	ENC_INBYTE
 ENC_INBYTE                       EQU 14                    ; 0XE
GLOBAL	ENC_OUTBYTE
 ENC_OUTBYTE                      EQU 15                    ; 0XF
GLOBAL	ENC_OUTBYTE1
 ENC_OUTBYTE1                     EQU 16                    ; 0X10
GLOBAL	ENC_OUTBYTE2
 ENC_OUTBYTE2                     EQU 17                    ; 0X11
GLOBAL	HSERPRINTCRLFCOUNT
 HSERPRINTCRLFCOUNT               EQU 18                    ; 0X12
GLOBAL	LASTSELECTEDBANK
 LASTSELECTEDBANK                 EQU 19                    ; 0X13
GLOBAL	MACADDR
 MACADDR                          EQU 1500                    ; 0X5DC
GLOBAL	MACON2
 MACON2                           EQU 20                    ; 0X14
GLOBAL	MICON1
 MICON1                           EQU 21                    ; 0X15
GLOBAL	MICON2
 MICON2                           EQU 22                    ; 0X16
GLOBAL	OUTVALUETEMP
 OUTVALUETEMP                     EQU 23                    ; 0X17
GLOBAL	PHYREGADDR
 PHYREGADDR                       EQU 24                    ; 0X18
GLOBAL	PRINTLEN
 PRINTLEN                         EQU 25                    ; 0X19
GLOBAL	SERDATA
 SERDATA                          EQU 26                    ; 0X1A
GLOBAL	SERPRINTVAL
 SERPRINTVAL                      EQU 27                    ; 0X1B
GLOBAL	SPICLOCKMODE
 SPICLOCKMODE                     EQU 28                    ; 0X1C
GLOBAL	SPICURRENTMODE
 SPICURRENTMODE                   EQU 29                    ; 0X1D
GLOBAL	SPIRXDATA
 SPIRXDATA                        EQU 30                    ; 0X1E
GLOBAL	SPITXDATA
 SPITXDATA                        EQU 31                    ; 0X1F
GLOBAL	STRINGPOINTER
 STRINGPOINTER                    EQU 32                    ; 0X20
GLOBAL	SYSBYTETEMPA
 SYSBYTETEMPA                     EQU 5                    ; 0X5
GLOBAL	SYSBYTETEMPB
 SYSBYTETEMPB                     EQU 9                    ; 0X9
GLOBAL	SYSBYTETEMPX
 SYSBYTETEMPX                     EQU 0                    ; 0X0
GLOBAL	SYSCALCTEMPA
 SYSCALCTEMPA                     EQU 5                    ; 0X5
GLOBAL	SYSCALCTEMPX
 SYSCALCTEMPX                     EQU 0                    ; 0X0
GLOBAL	SYSDIVLOOP
 SYSDIVLOOP                       EQU 4                    ; 0X4
GLOBAL	SYSMACADDRHANDLER
 SYSMACADDRHANDLER                EQU 33                    ; 0X21
GLOBAL	SYSMACADDRHANDLER_H
 SYSMACADDRHANDLER_H              EQU 34                    ; 0X22
GLOBAL	SYSPRINTDATAHANDLER
 SYSPRINTDATAHANDLER              EQU 35                    ; 0X23
GLOBAL	SYSPRINTDATAHANDLER_H
 SYSPRINTDATAHANDLER_H            EQU 36                    ; 0X24
GLOBAL	SYSPRINTTEMP
 SYSPRINTTEMP                     EQU 37                    ; 0X25
GLOBAL	SYSREPEATTEMP1
 SYSREPEATTEMP1                   EQU 38                    ; 0X26
GLOBAL	SYSSTRINGA
 SYSSTRINGA                       EQU 7                    ; 0X7
GLOBAL	SYSSTRINGA_H
 SYSSTRINGA_H                     EQU 8                    ; 0X8
GLOBAL	SYSSTRINGLENGTH
 SYSSTRINGLENGTH                  EQU 6                    ; 0X6
GLOBAL	SYSSTRINGPARAM1
 SYSSTRINGPARAM1                  EQU 1507                    ; 0X5E3
GLOBAL	SYSSTRINGTEMP
 SYSSTRINGTEMP                    EQU 39                    ; 0X27
GLOBAL	SYSTEMP1
 SYSTEMP1                         EQU 40                    ; 0X28
GLOBAL	SYSTEMP2
 SYSTEMP2                         EQU 41                    ; 0X29
GLOBAL	SYSVALTEMP
 SYSVALTEMP                       EQU 42                    ; 0X2A
GLOBAL	SYSWAITTEMPMS
 SYSWAITTEMPMS                    EQU 2                    ; 0X2
GLOBAL	SYSWAITTEMPMS_H
 SYSWAITTEMPMS_H                  EQU 3                    ; 0X3
GLOBAL	SYSWAITTEMPS
 SYSWAITTEMPS                     EQU 4                    ; 0X4
GLOBAL	TEMP
 TEMP                             EQU 43                    ; 0X2B
GLOBAL	XX
 XX                               EQU 44                    ; 0X2C
GLOBAL	_HEXPICAS
 _HEXPICAS                        EQU 1496                    ; 0X5D8

;********************************************************************************

;ALIAS VARIABLES
GLOBAL	AFSR0
 AFSR0                            EQU 4073
GLOBAL	AFSR0_H
 AFSR0_H                          EQU 4074
GLOBAL	SYS_HEXPICAS_0
 SYS_HEXPICAS_0                   EQU 1496
GLOBAL	SYS_HEXPICAS_1
 SYS_HEXPICAS_1                   EQU 1497
GLOBAL	SYS_HEXPICAS_2
 SYS_HEXPICAS_2                   EQU 1498

;********************************************************************************

 PSECT   RESETVEC,delta=1, abs
 RESETVEC:
;VECTORS
	ORG	0
	GOTO	BASPROGRAMSTART
	ORG	8
	RETFIE

;********************************************************************************

;START OF PROGRAM MEMORY PAGE 0
	ORG	12
GLOBAL	BASPROGRAMSTART
BASPROGRAMSTART:
;CALL INITIALISATION ROUTINES
	RCALL	INITSYS
	RCALL	INITUSART
;AUTOMATIC PIN DIRECTION SETTING
	BCF	TRISB,0,ACCESS
	BCF	TRISC,2,ACCESS

;START OF THE MAIN PROGRAM
;''A program  for GCGB and GCB.
;''--------------------------------------------------------------------------------------------------------------------------------
;'' Description  :  Setup ENC28J60, then reads data from the Ethernet stream to a PC terminal.
;''
;'' You NEED a PC terminal connected to the serial out on the microprocessor.
;''
;''@author    [todo]
;''@licence   GPL
;''@version   [todo]
;''@date      [todo]
;''********************************************************************************
;----- Configuration
;----- Constants
;#DEFINE Heartbeat       PortC.2
;#DEFINE ENC28J60_DI     PortC.4             'Connected to Device SO
;#DEFINE ENC28J60_DO     PortC.5             'Connected to Device SI
;#DEFINE ENC28J60_SCK    PortC.3             'Connected to Clock
;#DEFINE ENC28J60_CS     PortA.5             'Chip select line
;#DEFINE ENC28J60_RESET  PortD.2             'Reset line
;#DEFINE TX              PortC.7
;#DEFINE RX              PortC.6
;USART settings
;#DEFINE USART_BAUD_RATE 9600
;#DEFINE USART_BLOCKING
;#DEFINE USART_TX_BLOCKING
;#DEFINE debugport portb.0
;----- Define Hardware settings
;set debugport off
	BCF	LATB,0,ACCESS
;----- Variables
;No Variables specified in this example. All byte variables are defined upon use.
;----- Quick Command Reference:
;----- Main body of program commences here.
;wait 1 s
	MOVLW	1
	MOVWF	SYSWAITTEMPS,ACCESS
	RCALL	DELAY_S
;HSerPrintCRLF 2
	MOVLW	2
	MOVWF	HSERPRINTCRLFCOUNT,ACCESS
	MOVLW	1
	MOVWF	COMPORT,ACCESS
	RCALL	HSERPRINTCRLF
;HserPrint "ENC28J60 Ethernet Driver 005" : HSerPrintCRLF
	LFSR	1,SYSSTRINGPARAM1
	MOVLW	LOW STRINGTABLE2
	MOVWF	TBLPTR,ACCESS
	MOVLW	HIGH STRINGTABLE2
	MOVWF	TBLPTRH,ACCESS
	CALL	SYSREADSTRING
	MOVLW	LOW SYSSTRINGPARAM1
	MOVWF	SYSPRINTDATAHANDLER,ACCESS
	MOVLW	HIGH SYSSTRINGPARAM1
	MOVWF	SYSPRINTDATAHANDLER_H,ACCESS
	MOVLW	1
	MOVWF	COMPORT,ACCESS
;SYSSTRINGPARAM*1
	RCALL	HSERPRINT308
	MOVLW	1
	MOVWF	HSERPRINTCRLFCOUNT,ACCESS
	MOVLW	1
	MOVWF	COMPORT,ACCESS
	RCALL	HSERPRINTCRLF
;HserPrint "Init Test": HSerPrintCRLF
	LFSR	1,SYSSTRINGPARAM1
	MOVLW	LOW STRINGTABLE3
	MOVWF	TBLPTR,ACCESS
	MOVLW	HIGH STRINGTABLE3
	MOVWF	TBLPTRH,ACCESS
	CALL	SYSREADSTRING
	MOVLW	LOW SYSSTRINGPARAM1
	MOVWF	SYSPRINTDATAHANDLER,ACCESS
	MOVLW	HIGH SYSSTRINGPARAM1
	MOVWF	SYSPRINTDATAHANDLER_H,ACCESS
	MOVLW	1
	MOVWF	COMPORT,ACCESS
;SYSSTRINGPARAM*1
	RCALL	HSERPRINT308
	MOVLW	1
	MOVWF	HSERPRINTCRLFCOUNT,ACCESS
	MOVLW	1
	MOVWF	COMPORT,ACCESS
	RCALL	HSERPRINTCRLF
;PulseOut Heartbeat, 15 Ms
;Macro Source: stdbasic.h (186)
;Set Pin On
	BSF	LATC,2,ACCESS
;WaitL1 Time
	MOVLW	15
	MOVWF	SYSWAITTEMPMS,ACCESS
	CLRF	SYSWAITTEMPMS_H,ACCESS
	RCALL	DELAY_MS
;Set Pin Off
	BCF	LATC,2,ACCESS
;Set MAC address
;macaddr =  0x42, 0x00, 0x33, 0x44, 0x55, 0x66
	LFSR	0,MACADDR
	MOVLW	6
	MOVWF	POSTINC0,ACCESS
	MOVLW	66
	MOVWF	POSTINC0,ACCESS
	CLRF	POSTINC0,ACCESS
	MOVLW	51
	MOVWF	POSTINC0,ACCESS
	MOVLW	68
	MOVWF	POSTINC0,ACCESS
	MOVLW	85
	MOVWF	POSTINC0,ACCESS
	MOVLW	102
	MOVWF	POSTINC0,ACCESS
;ENC28J60_Init ( macaddr )
	MOVLW	LOW MACADDR
	MOVWF	SYSMACADDRHANDLER,ACCESS
	MOVLW	HIGH MACADDR
	MOVWF	SYSMACADDRHANDLER_H,ACCESS
	RCALL	ENC28J60_INIT
;Set address of PHY register to write
;ENC28J60_WriteReg(MIREGADR, PHLCON)
	MOVLW	212
	MOVWF	ADDR,ACCESS
	MOVLW	20
	MOVWF	ENC_OUTBYTE,ACCESS
	RCALL	ENC28J60_WRITEREG
;Set LEDA for link status display
;and LEDB for blink fast
;ENC28J60_WriteReg(MIWRL, 0b10100010)
	MOVLW	214
	MOVWF	ADDR,ACCESS
	MOVLW	162
	MOVWF	ENC_OUTBYTE,ACCESS
	RCALL	ENC28J60_WRITEREG
;ENC28J60_WriteReg(MIWRH, 0b00000100)
	MOVLW	215
	MOVWF	ADDR,ACCESS
	MOVLW	4
	MOVWF	ENC_OUTBYTE,ACCESS
	RCALL	ENC28J60_WRITEREG
;for xx = 1 to 5
;LEGACY METHOD
	CLRF	XX,ACCESS
GLOBAL	SYSFORLOOP1
SYSFORLOOP1:
	INCF	XX,F,ACCESS
;ENC28J60_WriteReg(ECOCON, xx)
	MOVLW	117
	MOVWF	ADDR,ACCESS
	MOVFF	XX,ENC_OUTBYTE
	RCALL	ENC28J60_WRITEREG
;wait 500 ms
	MOVLW	244
	MOVWF	SYSWAITTEMPMS,ACCESS
	MOVLW	1
	MOVWF	SYSWAITTEMPMS_H,ACCESS
	RCALL	DELAY_MS
;next
	MOVLW	5
	SUBWF	XX,W,ACCESS
	BTFSS	STATUS,0,ACCESS
	BRA	SYSFORLOOP1
GLOBAL	SYSFORLOOPEND1
SYSFORLOOPEND1:
;Has MAC address been saved? Display the MAC address
;HserPrint "Mac Address ":
	LFSR	1,SYSSTRINGPARAM1
	MOVLW	LOW STRINGTABLE4
	MOVWF	TBLPTR,ACCESS
	MOVLW	HIGH STRINGTABLE4
	MOVWF	TBLPTRH,ACCESS
	RCALL	SYSREADSTRING
	MOVLW	LOW SYSSTRINGPARAM1
	MOVWF	SYSPRINTDATAHANDLER,ACCESS
	MOVLW	HIGH SYSSTRINGPARAM1
	MOVWF	SYSPRINTDATAHANDLER_H,ACCESS
	MOVLW	1
	MOVWF	COMPORT,ACCESS
;SYSSTRINGPARAM*1
	RCALL	HSERPRINT308
;HserPrint hex(ENC28J60_ReadReg(MAADR1))+":"
	MOVLW	224
	MOVWF	ADDR,ACCESS
	RCALL	FN_ENC28J60_READREG
	MOVFF	ENC28J60_READREG,SYSVALTEMP
	RCALL	FN__HEXPICAS
	LFSR	1,SYSSTRINGPARAM1
	CLRF	SYSSTRINGLENGTH,ACCESS
	LFSR	0,_HEXPICAS
	RCALL	SYSCOPYSTRINGPART
	MOVLW	LOW STRINGTABLE5
	MOVWF	TBLPTR,ACCESS
	MOVLW	HIGH STRINGTABLE5
	MOVWF	TBLPTRH,ACCESS
	RCALL	SYSREADSTRINGPART
	LFSR	0,SYSSTRINGPARAM1
	MOVFF	SYSSTRINGLENGTH, INDF0
	MOVLW	LOW SYSSTRINGPARAM1
	MOVWF	SYSPRINTDATAHANDLER,ACCESS
	MOVLW	HIGH SYSSTRINGPARAM1
	MOVWF	SYSPRINTDATAHANDLER_H,ACCESS
	MOVLW	1
	MOVWF	COMPORT,ACCESS
;SYSSTRINGPARAM*1
	RCALL	HSERPRINT308
;HserPrint hex(ENC28J60_ReadReg(MAADR0))+":"
	MOVLW	225
	MOVWF	ADDR,ACCESS
	RCALL	FN_ENC28J60_READREG
	MOVFF	ENC28J60_READREG,SYSVALTEMP
	RCALL	FN__HEXPICAS
	LFSR	1,SYSSTRINGPARAM1
	CLRF	SYSSTRINGLENGTH,ACCESS
	LFSR	0,_HEXPICAS
	RCALL	SYSCOPYSTRINGPART
	MOVLW	LOW STRINGTABLE5
	MOVWF	TBLPTR,ACCESS
	MOVLW	HIGH STRINGTABLE5
	MOVWF	TBLPTRH,ACCESS
	RCALL	SYSREADSTRINGPART
	LFSR	0,SYSSTRINGPARAM1
	MOVFF	SYSSTRINGLENGTH, INDF0
	MOVLW	LOW SYSSTRINGPARAM1
	MOVWF	SYSPRINTDATAHANDLER,ACCESS
	MOVLW	HIGH SYSSTRINGPARAM1
	MOVWF	SYSPRINTDATAHANDLER_H,ACCESS
	MOVLW	1
	MOVWF	COMPORT,ACCESS
;SYSSTRINGPARAM*1
	RCALL	HSERPRINT308
;HserPrint hex(ENC28J60_ReadReg(MAADR3))+":"
	MOVLW	226
	MOVWF	ADDR,ACCESS
	RCALL	FN_ENC28J60_READREG
	MOVFF	ENC28J60_READREG,SYSVALTEMP
	RCALL	FN__HEXPICAS
	LFSR	1,SYSSTRINGPARAM1
	CLRF	SYSSTRINGLENGTH,ACCESS
	LFSR	0,_HEXPICAS
	RCALL	SYSCOPYSTRINGPART
	MOVLW	LOW STRINGTABLE5
	MOVWF	TBLPTR,ACCESS
	MOVLW	HIGH STRINGTABLE5
	MOVWF	TBLPTRH,ACCESS
	RCALL	SYSREADSTRINGPART
	LFSR	0,SYSSTRINGPARAM1
	MOVFF	SYSSTRINGLENGTH, INDF0
	MOVLW	LOW SYSSTRINGPARAM1
	MOVWF	SYSPRINTDATAHANDLER,ACCESS
	MOVLW	HIGH SYSSTRINGPARAM1
	MOVWF	SYSPRINTDATAHANDLER_H,ACCESS
	MOVLW	1
	MOVWF	COMPORT,ACCESS
;SYSSTRINGPARAM*1
	RCALL	HSERPRINT308
;HserPrint hex(ENC28J60_ReadReg(MAADR2))+":"
	MOVLW	227
	MOVWF	ADDR,ACCESS
	RCALL	FN_ENC28J60_READREG
	MOVFF	ENC28J60_READREG,SYSVALTEMP
	RCALL	FN__HEXPICAS
	LFSR	1,SYSSTRINGPARAM1
	CLRF	SYSSTRINGLENGTH,ACCESS
	LFSR	0,_HEXPICAS
	RCALL	SYSCOPYSTRINGPART
	MOVLW	LOW STRINGTABLE5
	MOVWF	TBLPTR,ACCESS
	MOVLW	HIGH STRINGTABLE5
	MOVWF	TBLPTRH,ACCESS
	RCALL	SYSREADSTRINGPART
	LFSR	0,SYSSTRINGPARAM1
	MOVFF	SYSSTRINGLENGTH, INDF0
	MOVLW	LOW SYSSTRINGPARAM1
	MOVWF	SYSPRINTDATAHANDLER,ACCESS
	MOVLW	HIGH SYSSTRINGPARAM1
	MOVWF	SYSPRINTDATAHANDLER_H,ACCESS
	MOVLW	1
	MOVWF	COMPORT,ACCESS
;SYSSTRINGPARAM*1
	RCALL	HSERPRINT308
;HserPrint hex(ENC28J60_ReadReg(MAADR5))+":"
	MOVLW	228
	MOVWF	ADDR,ACCESS
	RCALL	FN_ENC28J60_READREG
	MOVFF	ENC28J60_READREG,SYSVALTEMP
	RCALL	FN__HEXPICAS
	LFSR	1,SYSSTRINGPARAM1
	CLRF	SYSSTRINGLENGTH,ACCESS
	LFSR	0,_HEXPICAS
	RCALL	SYSCOPYSTRINGPART
	MOVLW	LOW STRINGTABLE5
	MOVWF	TBLPTR,ACCESS
	MOVLW	HIGH STRINGTABLE5
	MOVWF	TBLPTRH,ACCESS
	RCALL	SYSREADSTRINGPART
	LFSR	0,SYSSTRINGPARAM1
	MOVFF	SYSSTRINGLENGTH, INDF0
	MOVLW	LOW SYSSTRINGPARAM1
	MOVWF	SYSPRINTDATAHANDLER,ACCESS
	MOVLW	HIGH SYSSTRINGPARAM1
	MOVWF	SYSPRINTDATAHANDLER_H,ACCESS
	MOVLW	1
	MOVWF	COMPORT,ACCESS
;SYSSTRINGPARAM*1
	RCALL	HSERPRINT308
;HserPrint hex(ENC28J60_ReadReg(MAADR4)): HSerPrintCRLF
	MOVLW	229
	MOVWF	ADDR,ACCESS
	RCALL	FN_ENC28J60_READREG
	MOVFF	ENC28J60_READREG,SYSVALTEMP
	RCALL	FN__HEXPICAS
	MOVLW	LOW _HEXPICAS
	MOVWF	SYSPRINTDATAHANDLER,ACCESS
	MOVLW	HIGH _HEXPICAS
	MOVWF	SYSPRINTDATAHANDLER_H,ACCESS
	MOVLW	1
	MOVWF	COMPORT,ACCESS
	RCALL	HSERPRINT308
	MOVLW	1
	MOVWF	HSERPRINTCRLFCOUNT,ACCESS
	MOVLW	1
	MOVWF	COMPORT,ACCESS
	RCALL	HSERPRINTCRLF
;Show packets on the wire - move to library later.
;do
GLOBAL	SYSDOLOOP_S1
SYSDOLOOP_S1:
;PulseOut Heartbeat, 15 Ms
;Macro Source: stdbasic.h (186)
;Set Pin On
	BSF	LATC,2,ACCESS
;WaitL1 Time
	MOVLW	15
	MOVWF	SYSWAITTEMPMS,ACCESS
	CLRF	SYSWAITTEMPMS_H,ACCESS
	RCALL	DELAY_MS
;Set Pin Off
	BCF	LATC,2,ACCESS
;if (ENC28J60_ReadReg(EPKTCNT) = 1) then '* We received a packet
	MOVLW	57
	MOVWF	ADDR,ACCESS
	RCALL	FN_ENC28J60_READREG
	DECF	ENC28J60_READREG,W,ACCESS
	BTFSS	STATUS,2,ACCESS
	BRA	ELSE2_1
;data = stack_read() 'Call our stack layer to receive it
;ENC28J60_Select
	BCF	LATA,5,ACCESS
;FastHWSPITransfer  0b00111010, temp
	MOVLW	58
	MOVWF	SPITXDATA,ACCESS
	RCALL	FASTHWSPITRANSFER
;Read bytes
;for xx = 1 to 64
;LEGACY METHOD
	CLRF	XX,ACCESS
GLOBAL	SYSFORLOOP2
SYSFORLOOP2:
	INCF	XX,F,ACCESS
;Put byte to send into buffer
;Will start transfer
;SSPBUF = ENC28J60_READ_CTRL_REG | ( addr AND ADDR_MASK )
	MOVLW	31
	ANDWF	ADDR,W,ACCESS
	MOVWF	SYSTEMP1,ACCESS
	MOVFF	SYSTEMP1,SSPBUF
;Read buffer
;Wait While SSPSTAT.BF = Off
GLOBAL	SYSWAITLOOP1
SYSWAITLOOP1:
	BTFSS	SSPSTAT,0,ACCESS
	BRA	SYSWAITLOOP1
;HSerPrint SSPBUF
	MOVFF	SSPBUF,SERPRINTVAL
	MOVLW	1
	MOVWF	COMPORT,ACCESS
	RCALL	HSERPRINT309
;Set SSPSTAT.BF Off
	BCF	SSPSTAT,0,ACCESS
;if xx=14 then
	MOVLW	14
	SUBWF	XX,W,ACCESS
	BTFSS	STATUS,2,ACCESS
	BRA	ELSE3_1
;HSerPrint ":"
	LFSR	1,SYSSTRINGPARAM1
	MOVLW	LOW STRINGTABLE5
	MOVWF	TBLPTR,ACCESS
	MOVLW	HIGH STRINGTABLE5
	MOVWF	TBLPTRH,ACCESS
	RCALL	SYSREADSTRING
	MOVLW	LOW SYSSTRINGPARAM1
	MOVWF	SYSPRINTDATAHANDLER,ACCESS
	MOVLW	HIGH SYSSTRINGPARAM1
	MOVWF	SYSPRINTDATAHANDLER_H,ACCESS
	MOVLW	1
	MOVWF	COMPORT,ACCESS
;SYSSTRINGPARAM*1
	RCALL	HSERPRINT308
;Else
	BRA	ENDIF3
GLOBAL	ELSE3_1
ELSE3_1:
;HSerPrint " "
	LFSR	1,SYSSTRINGPARAM1
	MOVLW	LOW STRINGTABLE6
	MOVWF	TBLPTR,ACCESS
	MOVLW	HIGH STRINGTABLE6
	MOVWF	TBLPTRH,ACCESS
	RCALL	SYSREADSTRING
	MOVLW	LOW SYSSTRINGPARAM1
	MOVWF	SYSPRINTDATAHANDLER,ACCESS
	MOVLW	HIGH SYSSTRINGPARAM1
	MOVWF	SYSPRINTDATAHANDLER_H,ACCESS
	MOVLW	1
	MOVWF	COMPORT,ACCESS
;SYSSTRINGPARAM*1
	RCALL	HSERPRINT308
;end if
GLOBAL	ENDIF3
ENDIF3:
;next
	MOVLW	64
	SUBWF	XX,W,ACCESS
	BTFSS	STATUS,0,ACCESS
	BRA	SYSFORLOOP2
GLOBAL	SYSFORLOOPEND2
SYSFORLOOPEND2:
;Finish SPI command
;ENC28J60_DeSelect
	BSF	LATA,5,ACCESS
;Process received data here
;Decrease packet received counter
;ENC28J60_Select
	BCF	LATA,5,ACCESS
;FastHWSPITransfer(BFSCMD | ECON2, temp)
	MOVLW	158
	MOVWF	SPITXDATA,ACCESS
	RCALL	FASTHWSPITRANSFER
;FastHWSPITransfer(EPKTDEC , temp)
	MOVLW	64
	MOVWF	SPITXDATA,ACCESS
	RCALL	FASTHWSPITRANSFER
;ENC28J60_Deselect
	BSF	LATA,5,ACCESS
;else
GLOBAL	ELSE2_1
ELSE2_1:
;HSerPrint "."
;end if
GLOBAL	ENDIF2
ENDIF2:
;loop
	BRA	SYSDOLOOP_S1
GLOBAL	SYSDOLOOP_E1
SYSDOLOOP_E1:
;end
	BRA	BASPROGRAMEND
;----- Support methods.  Subroutines and Functions
;#DEFINE ENC28J60_Select         Set ENC28J60_CS off
;#DEFINE ENC28J60_Deselect       Set ENC28J60_CS on
;#DEFINE ENC28J60_Reset_CMD      Set ENC28J60_RESET on: Wait 10 ms :Set ENC28J60_RESET off: Wait 10 ms :Set ENC28J60_RESET on: Wait 10 ms
GLOBAL	CONFIGURATIONDETAILS
CONFIGURATIONDETAILS:
GLOBAL	BASPROGRAMEND
BASPROGRAMEND:
	SLEEP
	BRA	BASPROGRAMEND

;********************************************************************************

GLOBAL	DELAY_MS
DELAY_MS:
	INCF	SYSWAITTEMPMS_H, F,ACCESS
GLOBAL	DMS_START
DMS_START:
	MOVLW	227
	MOVWF	DELAYTEMP2,ACCESS
GLOBAL	DMS_OUTER
DMS_OUTER:
	MOVLW	6
	MOVWF	DELAYTEMP,ACCESS
GLOBAL	DMS_INNER
DMS_INNER:
	DECFSZ	DELAYTEMP, F,ACCESS
	BRA	DMS_INNER
	DECFSZ	DELAYTEMP2, F,ACCESS
	BRA	DMS_OUTER
	DECFSZ	SYSWAITTEMPMS, F,ACCESS
	BRA	DMS_START
	DECFSZ	SYSWAITTEMPMS_H, F,ACCESS
	BRA	DMS_START
	RETURN

;********************************************************************************

GLOBAL	DELAY_S
DELAY_S:
GLOBAL	DS_START
DS_START:
	MOVLW	232
	MOVWF	SYSWAITTEMPMS,ACCESS
	MOVLW	3
	MOVWF	SYSWAITTEMPMS_H,ACCESS
	RCALL	DELAY_MS
	DECFSZ	SYSWAITTEMPS, F,ACCESS
	BRA	DS_START
	RETURN

;********************************************************************************

;SOURCE: ENC28J60_005.H (5)
GLOBAL	ENC28J60_INIT
ENC28J60_INIT:
;'' Device ChipSelect control
;''
;Dir ENC28J60_DI in
	BSF	TRISC,4,ACCESS
;Dir ENC28J60_DO Out
	BCF	TRISC,5,ACCESS
;Dir ENC28J60_SCK Out
	BCF	TRISC,3,ACCESS
;Dir ENC28J60_CS out
	BCF	TRISA,5,ACCESS
;Dir ENC28J60_RESET out
	BCF	TRISD,2,ACCESS
;Initial state of ports required for SW SPI
;set ENC28J60_DO off
	BCF	LATC,5,ACCESS
;set ENC28J60_SCK off
	BCF	LATC,3,ACCESS
;set ENC28J60_CS off
	BCF	LATA,5,ACCESS
;Reset the NIC
;ENC28J60_Deselect
	BSF	LATA,5,ACCESS
;SPIMode MasterFast, 0
	MOVLW	13
	MOVWF	SPICURRENTMODE,ACCESS
	CLRF	SPICLOCKMODE,ACCESS
	RCALL	SPIMODE258
;ENC28J60_Reset_CMD
	BSF	LATD,2,ACCESS
	MOVLW	10
	MOVWF	SYSWAITTEMPMS,ACCESS
	CLRF	SYSWAITTEMPMS_H,ACCESS
	RCALL	DELAY_MS
	BCF	LATD,2,ACCESS
	MOVLW	10
	MOVWF	SYSWAITTEMPMS,ACCESS
	CLRF	SYSWAITTEMPMS_H,ACCESS
	RCALL	DELAY_MS
	BSF	LATD,2,ACCESS
	MOVLW	10
	MOVWF	SYSWAITTEMPMS,ACCESS
	CLRF	SYSWAITTEMPMS_H,ACCESS
	RCALL	DELAY_MS
;lastselectedBank = 99
	MOVLW	99
	MOVWF	LASTSELECTEDBANK,ACCESS
;wait while ( (ENC28J60_ReadReg( ESTAT ) & ESTAT_CLKRDY ) <> ESTAT_CLKRDY)
GLOBAL	SYSWAITLOOP2
SYSWAITLOOP2:
	MOVLW	29
	MOVWF	ADDR,ACCESS
	RCALL	FN_ENC28J60_READREG
	MOVLW	1
	ANDWF	ENC28J60_READREG,W,ACCESS
	MOVWF	SYSTEMP1,ACCESS
	MOVFF	SYSTEMP1,SYSBYTETEMPA
	MOVLW	1
	MOVWF	SYSBYTETEMPB,ACCESS
	RCALL	SYSCOMPEQUAL
	COMF	SYSBYTETEMPX,F,ACCESS
	BTFSC	SYSBYTETEMPX,0,ACCESS
	BRA	SYSWAITLOOP2
;Initialize NIC
;ENC28J60_writeReg(ECON1, 0xC0) 'Hold it in Reset
	MOVLW	31
	MOVWF	ADDR,ACCESS
	MOVLW	192
	MOVWF	ENC_OUTBYTE,ACCESS
	RCALL	ENC28J60_WRITEREG
;ENC28J60_writeReg(ECON2, 0x80) 'Set the AUTOINC bit
	MOVLW	30
	MOVWF	ADDR,ACCESS
	MOVLW	128
	MOVWF	ENC_OUTBYTE,ACCESS
	RCALL	ENC28J60_WRITEREG
;Configure interrupts
;ENC28J60_writeReg(EIR, 0x00) 'Reset interrupt flags
	MOVLW	28
	MOVWF	ADDR,ACCESS
	CLRF	ENC_OUTBYTE,ACCESS
	RCALL	ENC28J60_WRITEREG
;ENC28J60_writeReg(EIE,  0xC0)  'Interrupts: Packet reception
	MOVLW	27
	MOVWF	ADDR,ACCESS
	MOVLW	192
	MOVWF	ENC_OUTBYTE,ACCESS
	RCALL	ENC28J60_WRITEREG
;ENC28J60_writeReg(EWOLIE, 0x00)  'Disable wake-on-lan interrupts
	MOVLW	54
	MOVWF	ADDR,ACCESS
	CLRF	ENC_OUTBYTE,ACCESS
	RCALL	ENC28J60_WRITEREG
;ENC28J60_writeReg(EWOLIR, 0x00)  'Clear wake-on-lan interrupt flags
	MOVLW	55
	MOVWF	ADDR,ACCESS
	CLRF	ENC_OUTBYTE,ACCESS
	RCALL	ENC28J60_WRITEREG
;Allocate TX & RX buffers
;ENC28J60_writeReg(ETXSTL, ENC_TXBUF_STL)
	MOVLW	4
	MOVWF	ADDR,ACCESS
	MOVLW	112
	MOVWF	ENC_OUTBYTE,ACCESS
	RCALL	ENC28J60_WRITEREG
;ENC28J60_writeReg(ETXSTH, ENC_TXBUF_STH)
	MOVLW	5
	MOVWF	ADDR,ACCESS
	MOVLW	22
	MOVWF	ENC_OUTBYTE,ACCESS
	RCALL	ENC28J60_WRITEREG
;ENC28J60_writeReg(ETXNDL, ENC_TXBUF_NDL)
	MOVLW	6
	MOVWF	ADDR,ACCESS
	SETF	ENC_OUTBYTE,ACCESS
	RCALL	ENC28J60_WRITEREG
;ENC28J60_writeReg(ETXNDH, ENC_TXBUF_NDH)  'TX Buffer : 1800 bytes
	MOVLW	7
	MOVWF	ADDR,ACCESS
	MOVLW	31
	MOVWF	ENC_OUTBYTE,ACCESS
	RCALL	ENC28J60_WRITEREG
;ENC28J60_writeReg(ERXSTL, ENC_RXBUF_STL)
	MOVLW	8
	MOVWF	ADDR,ACCESS
	CLRF	ENC_OUTBYTE,ACCESS
	RCALL	ENC28J60_WRITEREG
;ENC28J60_writeReg(ERXSTH, ENC_RXBUF_STH)
	MOVLW	9
	MOVWF	ADDR,ACCESS
	CLRF	ENC_OUTBYTE,ACCESS
	RCALL	ENC28J60_WRITEREG
;ENC28J60_writeReg(ERXNDL, ENC_RXBUF_NDL)
	MOVLW	10
	MOVWF	ADDR,ACCESS
	MOVLW	110
	MOVWF	ENC_OUTBYTE,ACCESS
	RCALL	ENC28J60_WRITEREG
;ENC28J60_writeReg(ERXNDH, ENC_RXBUF_NDH)  'RX Buffer : 6390 bytes
	MOVLW	11
	MOVWF	ADDR,ACCESS
	CLRF	ENC_OUTBYTE,ACCESS
	RCALL	ENC28J60_WRITEREG
;ENC28J60_writeReg(ERDPTL, ENC_RXBUF_STL)
	CLRF	ADDR,ACCESS
	CLRF	ENC_OUTBYTE,ACCESS
	RCALL	ENC28J60_WRITEREG
;ENC28J60_writeReg(ERDPTH, ENC_RXBUF_STH)
	MOVLW	1
	MOVWF	ADDR,ACCESS
	CLRF	ENC_OUTBYTE,ACCESS
	RCALL	ENC28J60_WRITEREG
;ENC28J60_writeReg(ERXRDPTL, ENC_RXBUF_STL)
	MOVLW	12
	MOVWF	ADDR,ACCESS
	CLRF	ENC_OUTBYTE,ACCESS
	RCALL	ENC28J60_WRITEREG
;ENC28J60_writeReg(ERXRDPTH, ENC_RXBUF_STH) 'RX Pointers (same)
	MOVLW	13
	MOVWF	ADDR,ACCESS
	CLRF	ENC_OUTBYTE,ACCESS
	RCALL	ENC28J60_WRITEREG
;Set Receive Filters
;ENC28J60_writeReg(ERXFCON, 0xA1) 'Receive unicasts or broadcasts
	MOVLW	56
	MOVWF	ADDR,ACCESS
	MOVLW	161
	MOVWF	ENC_OUTBYTE,ACCESS
	RCALL	ENC28J60_WRITEREG
;Miscancellous
;ENC28J60_writeReg(EFLOCON, 0x00) 'Disable flow control sending
	MOVLW	119
	MOVWF	ADDR,ACCESS
	CLRF	ENC_OUTBYTE,ACCESS
	RCALL	ENC28J60_WRITEREG
;ENC28J60_writeReg(ECOCON, 0x00) 'Disable Clock Out pin
	MOVLW	117
	MOVWF	ADDR,ACCESS
	CLRF	ENC_OUTBYTE,ACCESS
	RCALL	ENC28J60_WRITEREG
;ENC28J60_writeReg(EBSTCON, 0x00) 'Disable built-in self test controller
	MOVLW	103
	MOVWF	ADDR,ACCESS
	CLRF	ENC_OUTBYTE,ACCESS
	RCALL	ENC28J60_WRITEREG
;Wait for the MAC & PHY parts to be operational
;wait while ( (ENC28J60_ReadReg(ESTAT) & ESTAT_CLKRDY) <> ESTAT_CLKRDY)
GLOBAL	SYSWAITLOOP3
SYSWAITLOOP3:
	MOVLW	29
	MOVWF	ADDR,ACCESS
	RCALL	FN_ENC28J60_READREG
	MOVLW	1
	ANDWF	ENC28J60_READREG,W,ACCESS
	MOVWF	SYSTEMP1,ACCESS
	MOVFF	SYSTEMP1,SYSBYTETEMPA
	MOVLW	1
	MOVWF	SYSBYTETEMPB,ACCESS
	RCALL	SYSCOMPEQUAL
	COMF	SYSBYTETEMPX,F,ACCESS
	BTFSC	SYSBYTETEMPX,0,ACCESS
	BRA	SYSWAITLOOP3
;Initialize MII interface
;ENC28J60_writeReg(MISTAT, 0x00)  'Clear MII status register
	MOVLW	234
	MOVWF	ADDR,ACCESS
	CLRF	ENC_OUTBYTE,ACCESS
	RCALL	ENC28J60_WRITEREG
;ENC28J60_writeReg(MICMD, 0x00)   'Clear MII command register
	MOVLW	210
	MOVWF	ADDR,ACCESS
	CLRF	ENC_OUTBYTE,ACCESS
	RCALL	ENC28J60_WRITEREG
;ENC28J60_writeReg(MICON1, 0x02)  'Fast MII operation
	MOVFF	MICON1,ADDR
	MOVLW	2
	MOVWF	ENC_OUTBYTE,ACCESS
	RCALL	ENC28J60_WRITEREG
;ENC28J60_writeReg(MICON2, 0x00)  'Release MII interface from reset
	MOVFF	MICON2,ADDR
	CLRF	ENC_OUTBYTE,ACCESS
	RCALL	ENC28J60_WRITEREG
;Initialize MAC subsystem
;ENC28J60_writeReg(MACON1, 0b00001101 )  'Enable packet reception
	MOVLW	192
	MOVWF	ADDR,ACCESS
	MOVLW	13
	MOVWF	ENC_OUTBYTE,ACCESS
	RCALL	ENC28J60_WRITEREG
;ENC28J60_writeReg(MACON2, 0x00)  'Release the MAC subsystem from reset
	MOVFF	MACON2,ADDR
	CLRF	ENC_OUTBYTE,ACCESS
	RCALL	ENC28J60_WRITEREG
;ENC28J60_writeReg(MACON3, 0xF0)  'Auto Pad + CRC + Half Duplex
	MOVLW	194
	MOVWF	ADDR,ACCESS
	MOVLW	240
	MOVWF	ENC_OUTBYTE,ACCESS
	RCALL	ENC28J60_WRITEREG
;ENC28J60_writeReg(MACON4, 0x01)  'Need valid preamble
	MOVLW	195
	MOVWF	ADDR,ACCESS
	MOVLW	1
	MOVWF	ENC_OUTBYTE,ACCESS
	RCALL	ENC28J60_WRITEREG
;ENC28J60_writeReg(MAPHSUP, 0b00010000) 'Release MAC-PHY support from Reset
	MOVLW	205
	MOVWF	ADDR,ACCESS
	MOVLW	16
	MOVWF	ENC_OUTBYTE,ACCESS
	RCALL	ENC28J60_WRITEREG
;ENC28J60_writeReg(MAMXFLL, 0xEE)
	MOVLW	202
	MOVWF	ADDR,ACCESS
	MOVLW	238
	MOVWF	ENC_OUTBYTE,ACCESS
	RCALL	ENC28J60_WRITEREG
;ENC28J60_writeReg(MAMXFLH, 0x5)  'Maximum frame length
	MOVLW	203
	MOVWF	ADDR,ACCESS
	MOVLW	5
	MOVWF	ENC_OUTBYTE,ACCESS
	RCALL	ENC28J60_WRITEREG
;ENC28J60_writeReg(MABBIPG, 0x12) 'IEEE BTB Inter Packet Gap
	MOVLW	196
	MOVWF	ADDR,ACCESS
	MOVLW	18
	MOVWF	ENC_OUTBYTE,ACCESS
	RCALL	ENC28J60_WRITEREG
;ENC28J60_writeReg(MAIPGL, 0x12)
	MOVLW	198
	MOVWF	ADDR,ACCESS
	MOVLW	18
	MOVWF	ENC_OUTBYTE,ACCESS
	RCALL	ENC28J60_WRITEREG
;ENC28J60_writeReg(MAIPGH, 0x0C)  'IEEE Non BTB Inter Packet Gap
	MOVLW	199
	MOVWF	ADDR,ACCESS
	MOVLW	12
	MOVWF	ENC_OUTBYTE,ACCESS
	RCALL	ENC28J60_WRITEREG
;Leave MACLCON1 and MACLCON2 to their default values
;Set MAC Address
;ENC28J60_writeReg(MAADR0, macaddr(2))
	MOVLW	225
	MOVWF	ADDR,ACCESS
	MOVLW	2
	ADDWF	SYSMACADDRHANDLER,W,ACCESS
	MOVWF	FSR0,ACCESS
	MOVLW	0
	ADDWFC	SYSMACADDRHANDLER_H,W,ACCESS
	MOVWF	FSR0H,ACCESS
	MOVFF	INDF0,ENC_OUTBYTE
	RCALL	ENC28J60_WRITEREG
;ENC28J60_writeReg(MAADR1, macaddr(1))
	MOVLW	224
	MOVWF	ADDR,ACCESS
	MOVLW	1
	ADDWF	SYSMACADDRHANDLER,W,ACCESS
	MOVWF	FSR0,ACCESS
	MOVLW	0
	ADDWFC	SYSMACADDRHANDLER_H,W,ACCESS
	MOVWF	FSR0H,ACCESS
	MOVFF	INDF0,ENC_OUTBYTE
	RCALL	ENC28J60_WRITEREG
;ENC28J60_writeReg(MAADR2, macaddr(4))
	MOVLW	227
	MOVWF	ADDR,ACCESS
	MOVLW	4
	ADDWF	SYSMACADDRHANDLER,W,ACCESS
	MOVWF	FSR0,ACCESS
	MOVLW	0
	ADDWFC	SYSMACADDRHANDLER_H,W,ACCESS
	MOVWF	FSR0H,ACCESS
	MOVFF	INDF0,ENC_OUTBYTE
	RCALL	ENC28J60_WRITEREG
;ENC28J60_writeReg(MAADR3, macaddr(3))
	MOVLW	226
	MOVWF	ADDR,ACCESS
	MOVLW	3
	ADDWF	SYSMACADDRHANDLER,W,ACCESS
	MOVWF	FSR0,ACCESS
	MOVLW	0
	ADDWFC	SYSMACADDRHANDLER_H,W,ACCESS
	MOVWF	FSR0H,ACCESS
	MOVFF	INDF0,ENC_OUTBYTE
	RCALL	ENC28J60_WRITEREG
;ENC28J60_writeReg(MAADR4, macaddr(6))
	MOVLW	229
	MOVWF	ADDR,ACCESS
	MOVLW	6
	ADDWF	SYSMACADDRHANDLER,W,ACCESS
	MOVWF	FSR0,ACCESS
	MOVLW	0
	ADDWFC	SYSMACADDRHANDLER_H,W,ACCESS
	MOVWF	FSR0H,ACCESS
	MOVFF	INDF0,ENC_OUTBYTE
	RCALL	ENC28J60_WRITEREG
;ENC28J60_writeReg(MAADR5, macaddr(5))
	MOVLW	228
	MOVWF	ADDR,ACCESS
	MOVLW	5
	ADDWF	SYSMACADDRHANDLER,W,ACCESS
	MOVWF	FSR0,ACCESS
	MOVLW	0
	ADDWFC	SYSMACADDRHANDLER_H,W,ACCESS
	MOVWF	FSR0H,ACCESS
	MOVFF	INDF0,ENC_OUTBYTE
	RCALL	ENC28J60_WRITEREG
;'Initialize PHY subsystem
;ENC28J60_writePhyReg(PHCON1, 0x00, 0x00)  'Half duplex
	CLRF	PHYREGADDR,ACCESS
	CLRF	ENC_OUTBYTE1,ACCESS
	CLRF	ENC_OUTBYTE2,ACCESS
	RCALL	ENC28J60_WRITEPHYREG
;ENC28J60_writePhyReg(PHCON2, 0x00, 0x00)
	MOVLW	16
	MOVWF	PHYREGADDR,ACCESS
	CLRF	ENC_OUTBYTE1,ACCESS
	CLRF	ENC_OUTBYTE2,ACCESS
	RCALL	ENC28J60_WRITEPHYREG
;ENC28J60_writePhyReg(PHLCON, 0B00000100, 0B01110110)
	MOVLW	20
	MOVWF	PHYREGADDR,ACCESS
	MOVLW	4
	MOVWF	ENC_OUTBYTE1,ACCESS
	MOVLW	118
	MOVWF	ENC_OUTBYTE2,ACCESS
	RCALL	ENC28J60_WRITEPHYREG
;ENC28J60_writePhyReg(PHIE, 0x00, 0x00)  'Disable interrupts
	MOVLW	18
	MOVWF	PHYREGADDR,ACCESS
	CLRF	ENC_OUTBYTE1,ACCESS
	CLRF	ENC_OUTBYTE2,ACCESS
	RCALL	ENC28J60_WRITEPHYREG
;Initialization done, release the NIC from reset
;ENC28J60_writeReg(ECON1, 0B00010100)
	MOVLW	31
	MOVWF	ADDR,ACCESS
	MOVLW	20
	MOVWF	ENC_OUTBYTE,ACCESS
	BRA	ENC28J60_WRITEREG
;We are done!!

;********************************************************************************

;SOURCE: ENC28J60_005.H (193)
GLOBAL	FN_ENC28J60_READREG
FN_ENC28J60_READREG:
;banktobeselected =  ( addr & BANK_MASK) / 32
	MOVLW	96
	ANDWF	ADDR,W,ACCESS
	MOVWF	SYSTEMP1,ACCESS
	MOVFF	SYSTEMP1,SYSBYTETEMPA
	MOVLW	32
	MOVWF	SYSBYTETEMPB,ACCESS
	RCALL	SYSDIVSUB
	MOVFF	SYSBYTETEMPA,BANKTOBESELECTED
;ENC28J60_selectBank ( banktobeselected, addr )
	RCALL	ENC28J60_SELECTBANK
;ENC28J60_Select
	BCF	LATA,5,ACCESS
;Read address
;Set SSPCON1.WCOL Off
	BCF	SSPCON1,7,ACCESS
;Put byte to send into buffer
;Will start transfer
;SSPBUF = ENC28J60_READ_CTRL_REG | ( addr AND ADDR_MASK )
	MOVLW	31
	ANDWF	ADDR,W,ACCESS
	MOVWF	SYSTEMP1,ACCESS
	MOVFF	SYSTEMP1,SSPBUF
;Read buffer
;Wait While SSPSTAT.BF = Off
GLOBAL	SYSWAITLOOP4
SYSWAITLOOP4:
	BTFSS	SSPSTAT,0,ACCESS
	BRA	SYSWAITLOOP4
;temp = SSPBUF
	MOVFF	SSPBUF,TEMP
;Set SSPSTAT.BF Off
	BCF	SSPSTAT,0,ACCESS
;Set SSPCON1.WCOL Off
	BCF	SSPCON1,7,ACCESS
;Put byte to send into buffer
;Will start transfer
;SSPBUF = 0
	CLRF	SSPBUF,ACCESS
;Read buffer
;Wait While SSPSTAT.BF = Off
GLOBAL	SYSWAITLOOP5
SYSWAITLOOP5:
	BTFSS	SSPSTAT,0,ACCESS
	BRA	SYSWAITLOOP5
;ENC_Inbyte = SSPBUF
	MOVFF	SSPBUF,ENC_INBYTE
;Set SSPSTAT.BF Off
	BCF	SSPSTAT,0,ACCESS
;Set SSPCON1.WCOL Off
	BCF	SSPCON1,7,ACCESS
;Put byte to send into buffer
;Will start transfer
;SSPBUF = 0
	CLRF	SSPBUF,ACCESS
;Read dummy value
;Wait While SSPSTAT.BF = Off
GLOBAL	SYSWAITLOOP6
SYSWAITLOOP6:
	BTFSS	SSPSTAT,0,ACCESS
	BRA	SYSWAITLOOP6
;ENC_Inbyte = SSPBUF
	MOVFF	SSPBUF,ENC_INBYTE
;Set SSPSTAT.BF Off
	BCF	SSPSTAT,0,ACCESS
;Set data result
;ENC28J60_Deselect
	BSF	LATA,5,ACCESS
;ENC28J60_ReadReg = ENC_Inbyte
	MOVFF	ENC_INBYTE,ENC28J60_READREG
	RETURN

;********************************************************************************

;SOURCE: ENC28J60_005.H (142)
GLOBAL	ENC28J60_SELECTBANK
ENC28J60_SELECTBANK:
;'These registers (EIE, EIR, ESTAT, ECON2, ECON1)
;'are present in all banks, no need to switch bank
;if ( addr >= EIE & addr <= ECON1 ) then
	MOVFF	ADDR,SYSBYTETEMPA
	MOVLW	27
	MOVWF	SYSBYTETEMPB,ACCESS
	RCALL	SYSCOMPLESSTHAN
	COMF	SYSBYTETEMPX,F,ACCESS
	MOVFF	SYSBYTETEMPX,SYSTEMP1
	MOVFF	ADDR,SYSBYTETEMPB
	MOVLW	31
	MOVWF	SYSBYTETEMPA,ACCESS
	RCALL	SYSCOMPLESSTHAN
	COMF	SYSBYTETEMPX,F,ACCESS
	MOVF	SYSTEMP1,W,ACCESS
	ANDWF	SYSBYTETEMPX,W,ACCESS
	MOVWF	SYSTEMP2,ACCESS
	BTFSC	SYSTEMP2,0,ACCESS
;exit Sub
	RETURN
;end if
;if lastselectedBank = banktobeselected then
	MOVF	BANKTOBESELECTED,W,ACCESS
	SUBWF	LASTSELECTEDBANK,W,ACCESS
	BTFSC	STATUS,2,ACCESS
;exit sub
	RETURN
;end if
;Set to ENC memory bank addr
;ENC28J60_Select
	BCF	LATA,5,ACCESS
;FastHWSPITransfer(BFCCMD | ECON1, temp)
	MOVLW	191
	MOVWF	SPITXDATA,ACCESS
	RCALL	FASTHWSPITRANSFER
;FastHWSPITransfer(0b00000011, temp)
	MOVLW	3
	MOVWF	SPITXDATA,ACCESS
	RCALL	FASTHWSPITRANSFER
;ENC28J60_Deselect
	BSF	LATA,5,ACCESS
;Set to ENC memory bank addr
;Select case banktobeselected
;case 1
GLOBAL	SYSSELECT1CASE1
SYSSELECT1CASE1:
	DECF	BANKTOBESELECTED,W,ACCESS
	BTFSS	STATUS,2,ACCESS
	BRA	SYSSELECT1CASE2
;ENC28J60_Select
	BCF	LATA,5,ACCESS
;FastHWSPITransfer(BFSCMD | ECON1, temp)
	MOVLW	159
	MOVWF	SPITXDATA,ACCESS
	RCALL	FASTHWSPITRANSFER
;FastHWSPITransfer(0b00000001 , temp)
	MOVLW	1
	MOVWF	SPITXDATA,ACCESS
	RCALL	FASTHWSPITRANSFER
;ENC28J60_Deselect
	BSF	LATA,5,ACCESS
;case 2
	BRA	SYSSELECTEND1
GLOBAL	SYSSELECT1CASE2
SYSSELECT1CASE2:
	MOVLW	2
	SUBWF	BANKTOBESELECTED,W,ACCESS
	BTFSS	STATUS,2,ACCESS
	BRA	SYSSELECT1CASE3
;ENC28J60_Select
	BCF	LATA,5,ACCESS
;FastHWSPITransfer(BFSCMD | ECON1, temp)
	MOVLW	159
	MOVWF	SPITXDATA,ACCESS
	RCALL	FASTHWSPITRANSFER
;FastHWSPITransfer(0b00000010 , temp)
	MOVLW	2
	MOVWF	SPITXDATA,ACCESS
	RCALL	FASTHWSPITRANSFER
;ENC28J60_Deselect
	BSF	LATA,5,ACCESS
;case 3
	BRA	SYSSELECTEND1
GLOBAL	SYSSELECT1CASE3
SYSSELECT1CASE3:
	MOVLW	3
	SUBWF	BANKTOBESELECTED,W,ACCESS
	BTFSS	STATUS,2,ACCESS
	BRA	SYSSELECTEND1
;ENC28J60_Select
	BCF	LATA,5,ACCESS
;FastHWSPITransfer(BFSCMD | ECON1, temp)
	MOVLW	159
	MOVWF	SPITXDATA,ACCESS
	RCALL	FASTHWSPITRANSFER
;FastHWSPITransfer(0b00000011 , temp)
	MOVLW	3
	MOVWF	SPITXDATA,ACCESS
	RCALL	FASTHWSPITRANSFER
;ENC28J60_Deselect
	BSF	LATA,5,ACCESS
;End Select
GLOBAL	SYSSELECTEND1
SYSSELECTEND1:
;lastselectedBank = banktobeselected
	MOVFF	BANKTOBESELECTED,LASTSELECTEDBANK
	RETURN

;********************************************************************************

;SOURCE: ENC28J60_005.H (131)
GLOBAL	ENC28J60_WRITEPHYREG
ENC28J60_WRITEPHYREG:
;Wait for the MII interface to be ready
;do while ((ENC28J60_ReadReg(MISTAT) & MISTAT_BUSY ) = 1)
GLOBAL	SYSDOLOOP_S2
SYSDOLOOP_S2:
	MOVLW	234
	MOVWF	ADDR,ACCESS
	RCALL	FN_ENC28J60_READREG
;ENC28J60_writeReg( MIREGADR, PhyRegaddr )
	MOVLW	212
	MOVWF	ADDR,ACCESS
	MOVFF	PHYREGADDR,ENC_OUTBYTE
	RCALL	ENC28J60_WRITEREG
;ENC28J60_writeReg( MIWRL, ENC_Outbyte1 )
	MOVLW	214
	MOVWF	ADDR,ACCESS
	MOVFF	ENC_OUTBYTE1,ENC_OUTBYTE
	RCALL	ENC28J60_WRITEREG
;ENC28J60_writeReg( MIWRH, ENC_Outbyte2 )
	MOVLW	215
	MOVWF	ADDR,ACCESS
	MOVFF	ENC_OUTBYTE2,ENC_OUTBYTE
	BRA	ENC28J60_WRITEREG

;********************************************************************************

;SOURCE: ENC28J60_005.H (119)
GLOBAL	ENC28J60_WRITEREG
ENC28J60_WRITEREG:
;banktobeselected = ( addr & BANK_MASK) / 32
	MOVLW	96
	ANDWF	ADDR,W,ACCESS
	MOVWF	SYSTEMP1,ACCESS
	MOVFF	SYSTEMP1,SYSBYTETEMPA
	MOVLW	32
	MOVWF	SYSBYTETEMPB,ACCESS
	RCALL	SYSDIVSUB
	MOVFF	SYSBYTETEMPA,BANKTOBESELECTED
;ENC28J60_selectBank ( banktobeselected, addr )
	RCALL	ENC28J60_SELECTBANK
;ENC28J60_Select
	BCF	LATA,5,ACCESS
;FastHWSPITransfer( ENC28J60_WRITE_CTRL_REG | (addr AND ADDR_MASK ), temp )
	MOVLW	31
	ANDWF	ADDR,W,ACCESS
	MOVWF	SYSTEMP1,ACCESS
	MOVLW	64
	IORWF	SYSTEMP1,W,ACCESS
	MOVWF	SPITXDATA,ACCESS
	RCALL	FASTHWSPITRANSFER
;FastHWSPITransfer( ENC_Outbyte, temp )
	MOVFF	ENC_OUTBYTE,SPITXDATA
	RCALL	FASTHWSPITRANSFER
;ENC28J60_Deselect
	BSF	LATA,5,ACCESS
	RETURN

;********************************************************************************

;SOURCE: HWSPI.H (704)
GLOBAL	FASTHWSPITRANSFER
FASTHWSPITRANSFER:
;Master mode only
;Clear WCOL
;Set SSPCON1.WCOL Off
	BCF	SSPCON1,7,ACCESS
;Put byte to send into buffer
;Will start transfer
;SSPBUF = SPITxData
	MOVFF	SPITXDATA,SSPBUF
;Same for master and slave
;Wait While SSPSTAT.BF = Off
GLOBAL	SYSWAITLOOP7
SYSWAITLOOP7:
	BTFSS	SSPSTAT,0,ACCESS
	BRA	SYSWAITLOOP7
;Set SSPSTAT.BF Off
	BCF	SSPSTAT,0,ACCESS
;Handle 18F chips
;SPIRxData = SSPBUF
	MOVFF	SSPBUF,SPIRXDATA
	RETURN

;********************************************************************************

;OVERLOADED SIGNATURE: STRING:BYTE:, SOURCE: USART.H (1426)
GLOBAL	HSERPRINT308
HSERPRINT308:
;PrintLen = PrintData(0)
	MOVFF	SYSPRINTDATAHANDLER,FSR0
	MOVFF	SYSPRINTDATAHANDLER_H,FSR0H
	MOVFF	INDF0,PRINTLEN
;If PrintLen <> 0 then
	MOVF	PRINTLEN,F,ACCESS
	BTFSC	STATUS,2,ACCESS
	BRA	ENDIF12
;Write Data
;for SysPrintTemp = 1 to PrintLen
	MOVLW	1
	MOVWF	SYSPRINTTEMP,ACCESS
GLOBAL	SYSFORLOOP4
SYSFORLOOP4:
;HSerSend(PrintData(SysPrintTemp),comport )
	MOVF	SYSPRINTTEMP,W,ACCESS
	ADDWF	SYSPRINTDATAHANDLER,W,ACCESS
	MOVWF	FSR0,ACCESS
	MOVLW	0
	ADDWFC	SYSPRINTDATAHANDLER_H,W,ACCESS
	MOVWF	FSR0H,ACCESS
	MOVFF	INDF0,SERDATA
	RCALL	HSERSEND298
;next
;#4P POSITIVE VALUE STEP HANDLER IN FOR-NEXT STATEMENT
	MOVF	SYSPRINTTEMP,W,ACCESS
	SUBWF	PRINTLEN,W,ACCESS
	MOVWF	SYSTEMP1,ACCESS
	MOVFF	SYSTEMP1,SYSBYTETEMPA
	CLRF	SYSBYTETEMPB,ACCESS
	RCALL	SYSCOMPEQUAL
	COMF	SYSBYTETEMPX,F,ACCESS
	BTFSS	SYSBYTETEMPX,0,ACCESS
	BRA	ENDIF13
;SET LOOPVAR TO LOOPVAR + STEPVALUE WHERE STEPVALUE IS A POSITIVE VALUE
	INCF	SYSPRINTTEMP,F,ACCESS
	BRA	SYSFORLOOP4
;END IF
GLOBAL	ENDIF13
ENDIF13:
GLOBAL	SYSFORLOOPEND4
SYSFORLOOPEND4:
;End If
GLOBAL	ENDIF12
ENDIF12:
;CR
	RETURN

;********************************************************************************

;OVERLOADED SIGNATURE: BYTE:BYTE:, SOURCE: USART.H (1449)
GLOBAL	HSERPRINT309
HSERPRINT309:
;OutValueTemp = 0
	CLRF	OUTVALUETEMP,ACCESS
;IF SerPrintVal >= 100 Then
	MOVLW	100
	SUBWF	SERPRINTVAL,W,ACCESS
	BTFSS	STATUS,0,ACCESS
	BRA	ENDIF14
;OutValueTemp = SerPrintVal / 100
	MOVFF	SERPRINTVAL,SYSBYTETEMPA
	MOVLW	100
	MOVWF	SYSBYTETEMPB,ACCESS
	RCALL	SYSDIVSUB
	MOVFF	SYSBYTETEMPA,OUTVALUETEMP
;SerPrintVal = SysCalcTempX
	MOVFF	SYSCALCTEMPX,SERPRINTVAL
;HSerSend(OutValueTemp + 48 ,comport )
	MOVLW	48
	ADDWF	OUTVALUETEMP,W,ACCESS
	MOVWF	SERDATA,ACCESS
	RCALL	HSERSEND298
;End If
GLOBAL	ENDIF14
ENDIF14:
;If OutValueTemp > 0 Or SerPrintVal >= 10 Then
	MOVFF	OUTVALUETEMP,SYSBYTETEMPB
	CLRF	SYSBYTETEMPA,ACCESS
	RCALL	SYSCOMPLESSTHAN
	MOVFF	SYSBYTETEMPX,SYSTEMP1
	MOVFF	SERPRINTVAL,SYSBYTETEMPA
	MOVLW	10
	MOVWF	SYSBYTETEMPB,ACCESS
	RCALL	SYSCOMPLESSTHAN
	COMF	SYSBYTETEMPX,F,ACCESS
	MOVF	SYSTEMP1,W,ACCESS
	IORWF	SYSBYTETEMPX,W,ACCESS
	MOVWF	SYSTEMP2,ACCESS
	BTFSS	SYSTEMP2,0,ACCESS
	BRA	ENDIF15
;OutValueTemp = SerPrintVal / 10
	MOVFF	SERPRINTVAL,SYSBYTETEMPA
	MOVLW	10
	MOVWF	SYSBYTETEMPB,ACCESS
	RCALL	SYSDIVSUB
	MOVFF	SYSBYTETEMPA,OUTVALUETEMP
;SerPrintVal = SysCalcTempX
	MOVFF	SYSCALCTEMPX,SERPRINTVAL
;HSerSend(OutValueTemp + 48 ,comport )
	MOVLW	48
	ADDWF	OUTVALUETEMP,W,ACCESS
	MOVWF	SERDATA,ACCESS
	RCALL	HSERSEND298
;End If
GLOBAL	ENDIF15
ENDIF15:
;HSerSend(SerPrintVal + 48 ,comport)
	MOVLW	48
	ADDWF	SERPRINTVAL,W,ACCESS
	MOVWF	SERDATA,ACCESS
	BRA	HSERSEND298
;CR

;********************************************************************************

;SOURCE: USART.H (1582)
GLOBAL	HSERPRINTCRLF
HSERPRINTCRLF:
;repeat HSerPrintCRLFCount
	MOVFF	HSERPRINTCRLFCOUNT,SYSREPEATTEMP1
	MOVF	SYSREPEATTEMP1,F,ACCESS
	BTFSC	STATUS,2,ACCESS
	BRA	SYSREPEATLOOPEND1
GLOBAL	SYSREPEATLOOP1
SYSREPEATLOOP1:
;HSerSend(13,comport)
	MOVLW	13
	MOVWF	SERDATA,ACCESS
	RCALL	HSERSEND298
;HSerSend(10,comport)
	MOVLW	10
	MOVWF	SERDATA,ACCESS
	RCALL	HSERSEND298
;end Repeat
	DECFSZ	SYSREPEATTEMP1,F,ACCESS
	BRA	SYSREPEATLOOP1
GLOBAL	SYSREPEATLOOPEND1
SYSREPEATLOOPEND1:
	RETURN

;********************************************************************************

;OVERLOADED SIGNATURE: BYTE:BYTE:, SOURCE: USART.H (892)
GLOBAL	HSERSEND298
HSERSEND298:
;Registers/Bits determined by #samevar at top of library
;if comport = 1 Then
	DECF	COMPORT,W,ACCESS
	BTFSS	STATUS,2,ACCESS
	BRA	ENDIF16
;USART_TX_BLOCKING
;Wait While TXIF = Off
GLOBAL	SYSWAITLOOP8
SYSWAITLOOP8:
	BTFSS	PIR1,4,ACCESS
	BRA	SYSWAITLOOP8
;ensure any previous operation has completed
;Wait until TRMT = 1
GLOBAL	SYSWAITLOOP9
SYSWAITLOOP9:
	BTFSS	TXSTA,1,ACCESS
	BRA	SYSWAITLOOP9
;Write the data byte to the USART.
;Sets register to value of SerData - where register could be TXREG or TXREG1 or U1TXB set via the #samevar
;TXREG = SerData
	MOVFF	SERDATA,TXREG
;Add USART_DELAY after the byte is sent by the USART module
;Wait USART_DELAY
	MOVLW	1
	MOVWF	SYSWAITTEMPMS,ACCESS
	CLRF	SYSWAITTEMPMS_H,ACCESS
	RCALL	DELAY_MS
;end if
GLOBAL	ENDIF16
ENDIF16:
	RETURN

;********************************************************************************

;SOURCE: SYSTEM.H (156)
GLOBAL	INITSYS
INITSYS:
;asm showdebug _For_selected_frequency_-_the_external_oscillator_has_been_selected_by_compiler ChipMHz
;asm showdebug _Complete_the_chip_setup_of_BSR,ADCs,ANSEL_and_other_key_setup_registers_or_register_bits
;Clear BSR on ChipFamily16 MCUs
;BSR = 0
	CLRF	BSR,ACCESS
;Clear TBLPTRU on MCUs with this bit as this must be zero
;TBLPTRU = 0
	CLRF	TBLPTRU,ACCESS
;Ensure all ports are set for digital I/O and, turn off A/D
;SET ADFM OFF
	BCF	ADCON2,7,ACCESS
;Switch off A/D Var(ADCON0)
;SET ADCON0.ADON OFF
	BCF	ADCON0,0,ACCESS
;SET PCFG3 ON
	BSF	ADCON1,3,ACCESS
;SET PCFG2 ON
	BSF	ADCON1,2,ACCESS
;SET PCFG1 ON
	BSF	ADCON1,1,ACCESS
;SET PCFG0 ON
	BSF	ADCON1,0,ACCESS
;Turn off comparator - this is the default setting
;CMCON = 7
	MOVLW	7
	MOVWF	CMCON,ACCESS
;
;'Turn off all ports
;PORTA = 0
	CLRF	PORTA,ACCESS
;PORTB = 0
	CLRF	PORTB,ACCESS
;PORTC = 0
	CLRF	PORTC,ACCESS
;PORTD = 0
	CLRF	PORTD,ACCESS
;PORTE = 0
	CLRF	PORTE,ACCESS
	RETURN

;********************************************************************************

;SOURCE: USART.H (571)
GLOBAL	INITUSART
INITUSART:
;asm showdebug Values_calculated_in_the_script
;asm showdebug _SPBRGH_TEMP=_ SPBRGH_TEMP
;asm showdebug _SPBRGL_TEMP=_ SPBRGL_TEMP
;asm showdebug _BRG16_TEMP=_ BRG16_TEMP
;asm showdebug _BRGH_TEMP=_ BRGH_TEMP
;Set baud rate for legacy chips
;SPBRG = SPBRGL_TEMP
	MOVLW	7
	MOVWF	SPBRG,ACCESS
;Set baud rate for chips with BRG16 bit
;SPBRGH = SPBRGH_TEMP
	MOVLW	2
	MOVWF	SPBRGH,ACCESS
;BRG16: 16-bit Baud Rate Generator bit
;1 = 16-bit Baud Rate Generator is used
;0 = 8-bit Baud Rate Generator is used
;BRG16 = BRG16_TEMP
	BSF	BAUDCON,3,ACCESS
;Set High Baud Rate Select bit
;BRGH = BRGH_TEMP
	BSF	TXSTA,2,ACCESS
;Enable async and TX mode for most non K42
;Set SYNC Off
;Set TXEN On
;Changed to canskip to silently exit when no USART
;[canskip]SYNC=0
	BCF	TXSTA,4,ACCESS
;[canskip]TXEN=1
	BSF	TXSTA,5,ACCESS
;SPEN=1
	BSF	RCSTA,7,ACCESS
;Enable TX and RX
;CREN=1
	BSF	RCSTA,4,ACCESS
	RETURN

;********************************************************************************

;OVERLOADED SIGNATURE: BYTE:BYTE:, SOURCE: HWSPI.H (378)
GLOBAL	SPIMODE258
SPIMODE258:
;Supports Legacy SPI via MSSP module
;added for 16f18855
;added for 16f18855
;added for 16f18855
;Turn off SPI
;(Prevents any weird glitches during setup)
;Set SSPCON1.SSPEN Off ;(Prevents any weird glitches during setup)
	BCF	SSPCON1,5,ACCESS
;Set clock pulse settings
;Set SSPSTAT.SMP Off
	BCF	SSPSTAT,7,ACCESS
;Set SSPSTAT.CKE Off
	BCF	SSPSTAT,6,ACCESS
;If SPIClockMode.0 = Off Then
	BTFSS	SPICLOCKMODE,0,ACCESS
;Set SSPSTAT.CKE On
	BSF	SSPSTAT,6,ACCESS
;End If
;Set SSPCON1.CKP Off
	BCF	SSPCON1,4,ACCESS
;If SPIClockMode.1 = On Then
	BTFSC	SPICLOCKMODE,1,ACCESS
;Set SSPCON1.CKP On
	BSF	SSPCON1,4,ACCESS
;End If
;Select mode and clock
;Set some mode bits off, can set on later
;Set SSPCON1.SSPM3 Off
	BCF	SSPCON1,3,ACCESS
;Set SSPCON1.SSPM2 Off
	BCF	SSPCON1,2,ACCESS
;Set SSPCON1.SSPM1 Off
	BCF	SSPCON1,1,ACCESS
;Set SSPCON1.SSPM0 Off
	BCF	SSPCON1,0,ACCESS
;Select Case SPICurrentMode
;Case MasterSSPADDMode   '1010
GLOBAL	SYSSELECT2CASE1
SYSSELECT2CASE1:
	MOVLW	16
	SUBWF	SPICURRENTMODE,W,ACCESS
	BTFSS	STATUS,2,ACCESS
	BRA	SYSSELECT2CASE2
;Set SSPCON1.SSPM3 On
	BSF	SSPCON1,3,ACCESS
;Set SSPCON1.SSPM1 On
	BSF	SSPCON1,1,ACCESS
;Case MasterUltraFast
	BRA	SYSSELECTEND2
GLOBAL	SYSSELECT2CASE2
SYSSELECT2CASE2:
	MOVLW	14
	SUBWF	SPICURRENTMODE,W,ACCESS
	BTFSS	STATUS,2,ACCESS
	BRA	SYSSELECT2CASE3
;Nothing to do on PIC
;Case MasterFast
	BRA	SYSSELECTEND2
GLOBAL	SYSSELECT2CASE3
SYSSELECT2CASE3:
	MOVLW	13
	SUBWF	SPICURRENTMODE,W,ACCESS
	BTFSS	STATUS,2,ACCESS
	BRA	SYSSELECT2CASE4
;Nothing to do
;Case Master
	BRA	SYSSELECTEND2
GLOBAL	SYSSELECT2CASE4
SYSSELECT2CASE4:
	MOVLW	12
	SUBWF	SPICURRENTMODE,W,ACCESS
	BTFSS	STATUS,2,ACCESS
	BRA	SYSSELECT2CASE5
;Set SSPCON1.SSPM0 On
	BSF	SSPCON1,0,ACCESS
;Case MasterSlow
	BRA	SYSSELECTEND2
GLOBAL	SYSSELECT2CASE5
SYSSELECT2CASE5:
	MOVLW	11
	SUBWF	SPICURRENTMODE,W,ACCESS
	BTFSS	STATUS,2,ACCESS
	BRA	SYSSELECT2CASE6
;Set SSPCON1.SSPM1 On
	BSF	SSPCON1,1,ACCESS
;Case Slave
	BRA	SYSSELECTEND2
GLOBAL	SYSSELECT2CASE6
SYSSELECT2CASE6:
	MOVF	SPICURRENTMODE,F,ACCESS
	BTFSS	STATUS,2,ACCESS
	BRA	SYSSELECT2CASE7
;Set SSPCON1.SSPM2 On
	BSF	SSPCON1,2,ACCESS
;Set SSPCON1.SSPM0 On
	BSF	SSPCON1,0,ACCESS
;Case SlaveSS
	BRA	SYSSELECTEND2
GLOBAL	SYSSELECT2CASE7
SYSSELECT2CASE7:
	DECF	SPICURRENTMODE,W,ACCESS
	BTFSS	STATUS,2,ACCESS
	BRA	SYSSELECTEND2
;Set SSPCON1.SSPM2 On
	BSF	SSPCON1,2,ACCESS
;End Select
GLOBAL	SYSSELECTEND2
SYSSELECTEND2:
;Enable SPI
;Set SSPCON1.SSPEN On
	BSF	SSPCON1,5,ACCESS
	RETURN

;********************************************************************************

;SOURCE: SYSTEM.H (2997)
GLOBAL	SYSCOMPEQUAL
SYSCOMPEQUAL:
;Dim SysByteTempA, SysByteTempB, SysByteTempX as byte
;setf SysByteTempX
	SETF	SYSBYTETEMPX,ACCESS
;movf SysByteTempB, W
	MOVF	SYSBYTETEMPB, W,ACCESS
;cpfseq SysByteTempA
	CPFSEQ	SYSBYTETEMPA,ACCESS
;clrf SysByteTempX
	CLRF	SYSBYTETEMPX,ACCESS
	RETURN

;********************************************************************************

;SOURCE: SYSTEM.H (3302)
GLOBAL	SYSCOMPLESSTHAN
SYSCOMPLESSTHAN:
;Dim SysByteTempA, SysByteTempB, SysByteTempX as byte
;setf SysByteTempX
	SETF	SYSBYTETEMPX,ACCESS
;movf SysByteTempB, W
	MOVF	SYSBYTETEMPB, W,ACCESS
;cpfslt SysByteTempA
	CPFSLT	SYSBYTETEMPA,ACCESS
;clrf SysByteTempX
	CLRF	SYSBYTETEMPX,ACCESS
	RETURN

;********************************************************************************

;SOURCE: SYSTEM.H (1293)
GLOBAL	SYSCOPYSTRING
SYSCOPYSTRING:
;Dim SysCalcTempA As Byte
;Dim SysStringLength As Byte
;Get and copy length for ChipFamily 16 support
;movff INDF0, SysCalcTempA
	MOVFF	INDF0, SYSCALCTEMPA
;movff SysCalcTempA, INDF1
	MOVFF	SYSCALCTEMPA, INDF1
;goto SysCopyStringCheck
	BRA	SYSCOPYSTRINGCHECK
;When appending, add length to counter
GLOBAL	SYSCOPYSTRINGPART
SYSCOPYSTRINGPART:
;movf INDF0, W
	MOVF	INDF0, W,ACCESS
;movwf SysCalcTempA
	MOVWF	SYSCALCTEMPA,ACCESS
;addwf SysStringLength, F
	ADDWF	SYSSTRINGLENGTH, F,ACCESS
GLOBAL	SYSCOPYSTRINGCHECK
SYSCOPYSTRINGCHECK:
;Exit if length = 0
;movf SysCalcTempA,F
	MOVF	SYSCALCTEMPA,F,ACCESS
;btfsc STATUS,Z
	BTFSC	STATUS,2,ACCESS
;return
	RETURN
GLOBAL	SYSSTRINGCOPY
SYSSTRINGCOPY:
;Copy character
;movff PREINC0, PREINC1
	MOVFF	PREINC0, PREINC1
;decfsz SysCalcTempA, F
	DECFSZ	SYSCALCTEMPA, F,ACCESS
;goto SysStringCopy
	BRA	SYSSTRINGCOPY
	RETURN

;********************************************************************************

;SOURCE: SYSTEM.H (2712)
GLOBAL	SYSDIVSUB
SYSDIVSUB:
;dim SysByteTempA as byte
;dim SysByteTempB as byte
;dim SysByteTempX as byte
;Check for div/0
;movf SysByteTempB, F
	MOVF	SYSBYTETEMPB, F,ACCESS
;btfsc STATUS, Z
	BTFSC	STATUS,2,ACCESS
;return
	RETURN
;Main calc routine
;SysByteTempX = 0
	CLRF	SYSBYTETEMPX,ACCESS
;SysDivLoop = 8
	MOVLW	8
	MOVWF	SYSDIVLOOP,ACCESS
GLOBAL	SYSDIV8START
SYSDIV8START:
;bcf STATUS, C
	BCF	STATUS,0,ACCESS
;rlf SysByteTempA, F
	RLCF	SYSBYTETEMPA, F,ACCESS
;rlf SysByteTempX, F
	RLCF	SYSBYTETEMPX, F,ACCESS
;movf SysByteTempB, W
	MOVF	SYSBYTETEMPB, W,ACCESS
;subwf SysByteTempX, F
	SUBWF	SYSBYTETEMPX, F,ACCESS
;bsf SysByteTempA, 0
	BSF	SYSBYTETEMPA, 0,ACCESS
;btfsc STATUS, C
	BTFSC	STATUS,0,ACCESS
;goto Div8NotNeg
	BRA	DIV8NOTNEG
;bcf SysByteTempA, 0
	BCF	SYSBYTETEMPA, 0,ACCESS
;movf SysByteTempB, W
	MOVF	SYSBYTETEMPB, W,ACCESS
;addwf SysByteTempX, F
	ADDWF	SYSBYTETEMPX, F,ACCESS
GLOBAL	DIV8NOTNEG
DIV8NOTNEG:
;decfsz SysDivLoop, F
	DECFSZ	SYSDIVLOOP, F,ACCESS
;goto SysDiv8Start
	BRA	SYSDIV8START
	RETURN

;********************************************************************************

;SOURCE: SYSTEM.H (1490)
GLOBAL	SYSREADSTRING
SYSREADSTRING:
;Dim SysCalcTempA As Byte
;Dim SysStringLength As Byte
;ChipFamily 16 support
;Get length
;TBLRD*+
	TBLRD*+
;movff TABLAT,SysCalcTempA
	MOVFF	TABLAT,SYSCALCTEMPA
;movff TABLAT,INDF1
	MOVFF	TABLAT,INDF1
;goto SysStringReadCheck
	BRA	SYSSTRINGREADCHECK
GLOBAL	SYSREADSTRINGPART
SYSREADSTRINGPART:
;TBLRD*+
	TBLRD*+
;movf TABLAT, W
	MOVF	TABLAT, W,ACCESS
;movwf SysCalcTempA
	MOVWF	SYSCALCTEMPA,ACCESS
;addwf SysStringLength,F
	ADDWF	SYSSTRINGLENGTH,F,ACCESS
;Check length
GLOBAL	SYSSTRINGREADCHECK
SYSSTRINGREADCHECK:
;If length is 0, exit
;movf SysCalcTempA,F
	MOVF	SYSCALCTEMPA,F,ACCESS
;btfsc STATUS,Z
	BTFSC	STATUS,2,ACCESS
;return
	RETURN
;Copy
GLOBAL	SYSSTRINGREAD
SYSSTRINGREAD:
;Copy char
;TBLRD*+
	TBLRD*+
;movff TABLAT,PREINC1
	MOVFF	TABLAT,PREINC1
;decfsz SysCalcTempA, F
	DECFSZ	SYSCALCTEMPA, F,ACCESS
;goto SysStringRead
	BRA	SYSSTRINGREAD
	RETURN

;********************************************************************************

GLOBAL	SYSSTRINGTABLES
SYSSTRINGTABLES:

GLOBAL	STRINGTABLE2
STRINGTABLE2:
	DB	28,69,78,67,50,56,74,54,48,32,69,116,104,101,114,110,101,116,32,68,114,105,118,101
	DB	114,32,48,48,53

	ALIGN	2;X3

GLOBAL	STRINGTABLE3
STRINGTABLE3:
	DB	9,73,110,105,116,32,84,101,115,116

	ALIGN	2;X3

GLOBAL	STRINGTABLE4
STRINGTABLE4:
	DB	12,77,97,99,32,65,100,100,114,101,115,115,32

	ALIGN	2;X3

GLOBAL	STRINGTABLE5
STRINGTABLE5:
	DB	1,58

	ALIGN	2;X3

GLOBAL	STRINGTABLE6
STRINGTABLE6:
	DB	1,32

	ALIGN	2;X3

;********************************************************************************

;SOURCE: PICAS.H (7)
GLOBAL	FN__HEXPICAS
FN__HEXPICAS:
;_HexPICAS(0) = 2
	MOVLW	2
	BANKSEL	SYS_HEXPICAS_0
	MOVWF	SYS_HEXPICAS_0,BANKED
;dim SysStringTemp as byte
;Low nibble
;SysStringTemp = SysValTemp And 0x0F
	MOVLW	15
	ANDWF	SYSVALTEMP,W,ACCESS
	BANKSEL	SYSSTRINGTEMP
	MOVWF	SYSSTRINGTEMP,BANKED
;If SysStringTemp > 9 Then SysStringTemp = SysStringTemp + 7
	SUBLW	9
	BTFSC	STATUS,0,ACCESS
	BRA	ENDIF7
	MOVLW	7
	ADDWF	SYSSTRINGTEMP,F,BANKED
GLOBAL	ENDIF7
ENDIF7:
;_HexPICAS(2) = SysStringTemp + 48
	MOVLW	48
	ADDWF	SYSSTRINGTEMP,W,BANKED
	BANKSEL	SYS_HEXPICAS_2
	MOVWF	SYS_HEXPICAS_2,BANKED
;Get high nibble
;For SysStringTemp = 1 to 4
;LEGACY METHOD
	BANKSEL	SYSSTRINGTEMP
	CLRF	SYSSTRINGTEMP,BANKED
GLOBAL	SYSFORLOOP3
SYSFORLOOP3:
	INCF	SYSSTRINGTEMP,F,BANKED
;Rotate SysValTemp Right
	RRCF	SYSVALTEMP,F,ACCESS
;Next
	MOVLW	4
	SUBWF	SYSSTRINGTEMP,W,BANKED
	BTFSS	STATUS,0,ACCESS
	BRA	SYSFORLOOP3
GLOBAL	SYSFORLOOPEND3
SYSFORLOOPEND3:
;SysStringTemp = SysValTemp And 0x0F
	MOVLW	15
	ANDWF	SYSVALTEMP,W,ACCESS
	MOVWF	SYSSTRINGTEMP,BANKED
;If SysStringTemp > 9 Then SysStringTemp = SysStringTemp + 7
	SUBLW	9
	BTFSC	STATUS,0,ACCESS
	BRA	ENDIF9
	MOVLW	7
	ADDWF	SYSSTRINGTEMP,F,BANKED
GLOBAL	ENDIF9
ENDIF9:
;_HexPICAS(1) = SysStringTemp + 48
	MOVLW	48
	ADDWF	SYSSTRINGTEMP,W,BANKED
	BANKSEL	SYS_HEXPICAS_1
	MOVWF	SYS_HEXPICAS_1,BANKED
	BANKSEL	0
	RETURN

;********************************************************************************

	ALIGN	2;X2
;
; Declare Power-On-Reset entry point
;
 END     RESETVEC
